## config/west.yml
```yaml
manifest:
  remotes:
    - name: luerl21
      url-base: https://github.com/luerl21
  projects:
    - name: zmk-old
      remote: luerl21
      revision: steno
      import: app/west.yml
  self:
    path: config
```
